## drivers/misc/disp_features/Kconfig
```kconfig
# SPDX-License-Identifier: GPL-2.0-only
config MI_DISP_FEATURES
	tristate "Xiaomi Display Features (HBM and DC Dimming)"
	default y
	help
	  Exposes sysfs control nodes under /sys/kernel/display_features/
	  for High Brightness Mode (HBM) and DC Dimming toggle.
```

## drivers/misc/hwid/Kconfig
```kconfig
# SPDX-License-Identifier: GPL-2.0-only
#
# Xiaomi Hardware ID Driver configuration
#

config MI_HARDWARE_ID
	tristate "Xiaomi Hardware ID driver"
	default m
	help
	  Say Y or M here to support Xiaomi Hardware ID detection.
	  This driver exposes hardware revision, project ID, and ADC values
	  via sysfs attributes under /sys/devices/platform/hwid/.

	  To compile this driver as a module, choose M here: the module
	  will be called hwid.
```
